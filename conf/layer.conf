## conf/layer.conf
```bitbake
# SPDX-License-Identifier: MIT
BBPATH .= ":${LAYERDIR}"
BBFILES += "${LAYERDIR}/recipes-*/*/*.bb ${LAYERDIR}/recipes-*/*/*.bbappend"
BBFILE_COLLECTIONS += "richyoflutter"
BBFILE_PATTERN_richyoflutter = "^${LAYERDIR}/"
BBFILE_PRIORITY_richyoflutter = "8"
LAYERDEPENDS_richyoflutter = "core"
LAYERSERIES_COMPAT_richyoflutter = "wrynose"

BBFILES_DYNAMIC += "flutter-layer:${LAYERDIR}/dynamic-layers/flutter-layer/recipes-*/*/*.bb flutter-layer:${LAYERDIR}/dynamic-layers/flutter-layer/recipes-*/*/*.bbappend"
```
